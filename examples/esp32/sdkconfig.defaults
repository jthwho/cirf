## examples/esp32/sdkconfig.defaults
```kconfig
# CIRF Runtime Configuration
# These are the recommended settings for ESP32

# Disable FILE* functions (fmemopen not available on ESP-IDF)
CONFIG_CIRF_NO_STDIO=y

# Disable mount system (avoids malloc, simpler for embedded)
CONFIG_CIRF_NO_MOUNT=y

# Maximum path length for lookups (reduce for memory-constrained devices)
CONFIG_CIRF_MAX_PATH=128

# Optional: Reduce default stack size if needed
# CONFIG_ESP_MAIN_TASK_STACK_SIZE=4096
```

## idf_component/Kconfig
```kconfig
menu "CIRF Runtime Configuration"

    config CIRF_MAX_PATH
        int "Maximum path length for lookups"
        default 256
        range 64 1024
        help
            Maximum path length for cirf_find_file() and cirf_find_folder().
            Uses stack allocation. Reduce for memory-constrained devices.

    config CIRF_NO_STDIO
        bool "Disable FILE* functions"
        default y
        help
            Disable cirf_fopen() and related functions.
            Recommended for ESP32 as fmemopen() is not available.

    config CIRF_NO_MOUNT
        bool "Disable mount system"
        default y
        help
            Disable cirf_mount() and related functions.
            Saves code size and avoids malloc/free usage.
            Recommended for simple embedded projects.

endmenu
```
